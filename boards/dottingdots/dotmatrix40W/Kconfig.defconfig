## boards/dottingdots/dotmatrix40W/Kconfig.defconfig
```kconfig
# Copyright (c) 2021 Nick Winans
# SPDX-License-Identifier: MIT

if BOARD_DOTMATRIX40W

config ZMK_KEYBOARD_NAME
    default "dotmatrix40W"

if USB_DEVICE_STACK

config USB_NRFX
    default y

endif # USB_DEVICE_STACK

config BT_CTLR
    default BT

choice ZMK_BOOTMODE_MAGIC_VALUE_BOOTLOADER_TYPE
    default ZMK_BOOTMODE_MAGIC_VALUE_BOOTLOADER_TYPE_ADAFRUIT_NRF52
endchoice

endif # BOARD_DOTMATRIX40W
```

## boards/dottingdots/dotmatrix40W/Kconfig.dotmatrix40W
```kconfig
# Copyright (c) 2021 Nick Winans
# Copyright (c) 2026 Tano Karbou (github: karbou12 / X: @karbou_12)
# SPDX-License-Identifier: MIT

config BOARD_DOTMATRIX40W
    select SOC_NRF52840_QIAA

    # Bootloader Support
    select ZMK_BOARD_COMPAT if BOARD_DOTMATRIX40W_NRF52840_ZMK
    imply RETAINED_MEM if BOARD_DOTMATRIX40W_NRF52840_ZMK
    imply RETENTION if BOARD_DOTMATRIX40W_NRF52840_ZMK
    imply RETENTION_BOOT_MODE if BOARD_DOTMATRIX40W_NRF52840_ZMK
```

## boards/dottingdots/dotmatrix40W/board.yml
```yaml
board:
  name: dotmatrix40W
  vendor: dottingdots
  socs:
    - name: nrf52840
      variants:
        - name: zmk
```

## boards/dottingdots/dotmatrix40W/dotmatrix40W_zmk_defconfig
```kconfig
# Copyright (c) 2021 Nick Winans
# Copyright 2026 Tano Karbou (github: karbou12 / X: @karbou_12)
# SPDX-License-Identifier: MIT

# Enable MPU
CONFIG_ARM_MPU=y

CONFIG_PINCTRL=y

# enable GPIO
CONFIG_GPIO=y

CONFIG_USE_DT_CODE_PARTITION=y
CONFIG_BUILD_OUTPUT_UF2=n

CONFIG_MPU_ALLOW_FLASH_WRITE=y
CONFIG_NVS=y
CONFIG_SETTINGS_NVS=y
CONFIG_FLASH=y
CONFIG_FLASH_PAGE_LAYOUT=y
CONFIG_FLASH_MAP=y

CONFIG_ZMK_USB=y
CONFIG_ZMK_BLE=y

CONFIG_ZMK_BACKLIGHT=y
CONFIG_ZMK_BACKLIGHT_BRT_STEP=4
CONFIG_LED=y
CONFIG_LED_PWM=y
CONFIG_PWM=y
CONFIG_REGULATOR=y
CONFIG_REGULATOR_FIXED=y
CONFIG_EC11=y
CONFIG_EC11_TRIGGER_GLOBAL_THREAD=y
CONFIG_ZMK_STUDIO=y
CONFIG_ZMK_STUDIO_LOCKING=n

# Battery Reporting
CONFIG_ADC=y
CONFIG_ZMK_BATTERY_REPORTING=y
CONFIG_ZMK_NON_LIPO_BATTERY_MANAGEMENT=y
CONFIG_ZMK_NON_LIPO_MAX_MV=1350
CONFIG_ZMK_NON_LIPO_MIN_MV=1000
CONFIG_ZMK_NON_LIPO_LOW_MV=900
```

## config/west.yml
```yaml
manifest:
  defaults:
    revision: main
  remotes:
    - name: zmkfirmware
      url-base: https://github.com/zmkfirmware
    - name: sekigon-gonnoc
      url-base: https://github.com/sekigon-gonnoc
    - name: amgskobo
      url-base: https://github.com/amgskobo
  projects:
    - name: zmk
      remote: zmkfirmware
      import: app/west.yml
    - name: zmk-feature-non-lipo-battery-management
      remote: sekigon-gonnoc
      revision: main
    - name: zmk-input-inertia
      remote: amgskobo
      revision: main
  self:
    path: config
```
